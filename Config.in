## Config.in
```kconfig
# Add project-specific packages for Buildroot here
#
# If these are non-proprietary, please consider contributing them back to
# Nerves or Buildroot.

menu "Rock 5T Hardware Acceleration"

source "$NERVES_DEFCONFIG_DIR/package/rockchip-libmali-g610/Config.in"
source "$NERVES_DEFCONFIG_DIR/package/rockchip-mpp/Config.in"
source "$NERVES_DEFCONFIG_DIR/package/rockchip-rknpu2/Config.in"
source "$NERVES_DEFCONFIG_DIR/package/rknpu/Config.in"
source "$NERVES_DEFCONFIG_DIR/package/rtw89-oot/Config.in"

endmenu

menu "Rock 5T Application Packages"

source "$NERVES_DEFCONFIG_DIR/package/cog-ai-extension/Config.in"
source "$NERVES_DEFCONFIG_DIR/package/gstreamer-rockchip/Config.in"
source "$NERVES_DEFCONFIG_DIR/package/rknn-infer/Config.in"

endmenu
```

## package/cog-ai-extension/Config.in
```kconfig
config BR2_PACKAGE_COG_AI_EXTENSION
	bool "cog-ai-extension"
	depends on BR2_PACKAGE_COG
	help
	  WebKit web extension for Cog/WPE that injects an AI overlay
	  into web pages. Provides YOLO object detection and Whisper
	  speech transcription buttons that communicate with the Phoenix
	  backend via WebSocket.
```

## package/rknn-infer/Config.in
```kconfig
config BR2_PACKAGE_RKNN_INFER
	bool "rknn-infer"
	depends on BR2_aarch64
	depends on BR2_PACKAGE_ROCKCHIP_RKNPU2
	help
	  RKNN inference helper for Whisper and YOLO models.
	  Uses librknnrt.so for model loading and NPU inference.
	  Communicates with Elixir via stdin/stdout binary protocol.
```
